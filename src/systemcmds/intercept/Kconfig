## src/systemcmds/intercept/Kconfig
```kconfig
menuconfig SYSTEMCMDS_INTERCEPT
	bool "intercept"
	default n
	---help---
		Publish an InterceptSetpoint and switch to AUTO_INTERCEPT (dev/SITL helper).
```
